## esp32_gateway/main/Kconfig.projbuild
```kconfig
menu "SNTP Configuration"

    config SNTP_TIME_SERVER
        string "SNTP server name"
        default "pool.ntp.org"
        help
            Hostname of the main SNTP server.

endmenu
```
